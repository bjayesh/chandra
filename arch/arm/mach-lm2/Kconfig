## arch/arm/mach-lm2/Kconfig
```kconfig
menu "Versatile Express platform type"
	depends on ARCH_LM2

config ARCH_VEXPRESS_CORTEX_A5_A9_ERRATA
	bool
	select ARM_ERRATA_720789
	select ARM_ERRATA_751472
	select PL310_ERRATA_753970 if CACHE_PL310
	help
	  Provides common dependencies for Versatile Express platforms
	  based on Cortex-A5 and Cortex-A9 processors. In order to
	  build a working kernel, you must also enable relevant core
	  tile support or Flattened Device Tree based support options.

config ARCH_LM2_DT
	bool "Device Tree support for LM2 Waikiki platforms"
	select ARCH_VEXPRESS_CORTEX_A5_A9_ERRATA
	select ARM_GIC
	select ARM_PATCH_PHYS_VIRT
	select AUTO_ZRELADDR
	select CPU_V7
	select HAVE_SMP
	select MIGHT_HAVE_CACHE_L2X0
	select USE_OF
	help
	  If your bootloader supports Flattened Device Tree based booting,
	  say Y here.

config ARCH_LM2_STATIC
	bool "Device Tree not support for LM2 Waikiki platforms"
	select ARCH_VEXPRESS_CORTEX_A5_A9_ERRATA
	select ARM_GIC
	select ARM_PATCH_PHYS_VIRT
	select CPU_V7
	select MIGHT_HAVE_CACHE_L2X0
	help
	  If your bootloader supports Flattened Device Tree based booting,
	  say Y here.

endmenu
```
